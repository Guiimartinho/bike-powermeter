## zephyr_app/Kconfig
```kconfig
# Options of the bike power meter itself (NCS v3.3.0).
#
# The application Kconfig sources the Zephyr one at the end, as the Zephyr
# application development guide describes.

menu "Bike power meter"

config PM_ANT_DEVICE_TYPE_CHECK
	bool
	default y
	help
	  Placeholder so the menu is never empty: the ANT+ channel numbers of
	  the Bicycle Power profile come from the sdk-ant add-on
	  (ant_profiles/bpwr/ant_bpwr.h), never from this repository.

config PM_HW_REVISION
	int "Hardware revision reported over ANT+ (page 80) and in the DIS"
	default 1
	range 0 255

config PM_MODEL_NUMBER
	int "Model number reported over ANT+ (page 80)"
	default 1
	range 0 65535

config PM_ANT_MANUFACTURER_ID
	int "ANT+ manufacturer id (page 80); 255 is the development value of the profile"
	default 255
	range 0 65535

config PM_STATUS_PERIOD_MS
	int "Period of the status characteristic and of the 1 Hz measurement, ms"
	default 1000
	range 250 5000

config PM_IDLE_BURST_PERIOD_MS
	int "In Idle, one burst of bridge samples every this many ms (auto zero and health)"
	default 10000
	range 1000 60000

config PM_IMU_AXIS_RADIAL
	int "Axis of the accelerometer along the crank arm (0 X, 1 Y, 2 Z)"
	default 1
	range 0 2
	help
	  A fact of the board, measured on 2026-09-27 and not guessed: the
	  orientation table of BST-BMA400-DS000-14 section 8.2, read against the
	  pin 1 corner of the U401 footprint and the part's rotation on the
	  board, puts the package's Y along the arm and its X across it. The
	  requirement these three symbols satisfy is in docs/02-hardware.md,
	  "Orientacao do acelerometro", and rule IM1 of the board's dry run
	  fails while the board and these values disagree. Swapping radial and
	  tangential feeds the centripetal term into the cadence and the power
	  comes out wrong with no error anywhere, so neither side moves alone.

config PM_IMU_AXIS_TANGENTIAL
	int "Axis of the accelerometer across the arm, in the plane of rotation (0 X, 1 Y, 2 Z)"
	default 0
	range 0 2

config PM_IMU_RADIAL_SIGN
	int "Sign that makes the radial axis positive outward (1 or -1)"
	default -1
	range -1 1
	help
	  The package's positive Y points at the left end of the board, which is
	  the axle side, and the model wants radial positive outward, from the
	  axle to the pedal: hence -1. The tangential sign is not here; it is
	  the tangential_sign setting, so the same firmware serves a pod on
	  either crank arm.

endmenu

source "Kconfig.zephyr"
```

## zephyr_app/boards/pm/pmboard/Kconfig.defconfig
```kconfig
# SPDX-License-Identifier: CC-BY-NC-4.0

if BOARD_PMBOARD_NRF54L15_CPUAPP

config HW_STACK_PROTECTION
	default ARCH_HAS_STACK_PROTECTION

endif # BOARD_PMBOARD_NRF54L15_CPUAPP
```

## zephyr_app/boards/pm/pmboard/Kconfig.pmboard
```kconfig
# SPDX-License-Identifier: CC-BY-NC-4.0

config BOARD_PMBOARD
	select SOC_NRF54L15_CPUAPP if BOARD_PMBOARD_NRF54L15_CPUAPP
```

## zephyr_app/boards/pm/pmboard/board.yml
```yaml
board:
  name: pmboard
  full_name: Bike power meter crank pod (custom board)
  vendor: pm
  socs:
  - name: nrf54l15
```

## zephyr_app/modules/pm_drivers/Kconfig
```kconfig
# SPDX-License-Identifier: CC-BY-NC-4.0

menu "Bike power meter drivers"

rsource "drivers/adc/Kconfig"
rsource "drivers/sensor/Kconfig"

endmenu
```

## zephyr_app/modules/pm_drivers/drivers/adc/Kconfig
```kconfig
# SPDX-License-Identifier: CC-BY-NC-4.0

config PM_ADC_ADS1220
	bool "ADS1220 bridge converter (ti,ads1220)"
	default y
	depends on DT_HAS_TI_ADS1220_ENABLED
	select SPI
	select GPIO
	help
	  TI ADS1220 24-bit converter with PGA, read on its DRDY edge by the
	  sample service through drivers/adc/ads1220.h.

if PM_ADC_ADS1220

config PM_ADC_ADS1220_INIT_PRIORITY
	int "Init priority of the converter, after the SPI bus"
	default 75

module = PM_ADC_ADS1220
module-str = ads1220
source "subsys/logging/Kconfig.template.log_config"

endif
```

## zephyr_app/modules/pm_drivers/drivers/sensor/Kconfig
```kconfig
# SPDX-License-Identifier: CC-BY-NC-4.0

config PM_SENSOR_BMA400
	bool "BMA400 accelerometer (bosch,bma400)"
	default y
	depends on DT_HAS_BOSCH_BMA400_ENABLED
	depends on SENSOR
	select SPI
	select GPIO
	help
	  Bosch BMA400 on SPI by the Zephyr sensor API, with the data-ready
	  and wake-up triggers on INT1. The bosch,bma4xx driver of the tree
	  carries the BMA422 register map and does not operate this part.

if PM_SENSOR_BMA400

config PM_SENSOR_BMA400_THREAD_STACK_SIZE
	int "Stack of the trigger thread"
	default 1536
	help
	  The interrupt only gives a semaphore; this thread calls the handler
	  of the motion service, which gives another semaphore and returns.

config PM_SENSOR_BMA400_THREAD_PRIORITY
	int "Priority of the trigger thread"
	default 4

module = PM_SENSOR_BMA400
module-str = bma400
source "subsys/logging/Kconfig.template.log_config"

endif
```

## zephyr_app/modules/pm_drivers/dts/bindings/adc/ti,ads1220.yaml
```yaml
# SPDX-License-Identifier: CC-BY-NC-4.0

description: |
  Texas Instruments ADS1220 24-bit delta-sigma converter with PGA, driven by
  the API of drivers/adc/ads1220.h (not the Zephyr ADC API): the bridge of
  the power meter is read in continuous conversion on the DRDY edge, and the
  reference monitor and the power-down are part of the measurement cycle.
  Register fields from SBAS501D (revision May 2026), table 8-8.

compatible: "ti,ads1220"

include: spi-device.yaml

properties:
  drdy-gpios:
    type: phandle-array
    required: true
    description: |
      The DRDY pin, driven low by the converter when a result is ready
      (datasheet 8.5.1.3). Active low.

  gain:
    type: int
    default: 128
    enum: [1, 2, 4, 8, 16, 32, 64, 128]
    description: "PGA gain (CONFIG0 GAIN[2:0])."

  data-rate:
    type: int
    default: 175
    enum: [20, 45, 90, 175, 330, 600, 1000]
    description: "Data rate in normal mode, samples per second (CONFIG1 DR[2:0], table 8-12)."

  mux:
    type: int
    default: 0
    description: |
      Input multiplexer setting (CONFIG0 MUX[3:0], table 8-10): 0 is
      AINP = AIN0, AINN = AIN1, the bridge output of the power meter.

  vref:
    type: string
    default: "refp0"
    enum: ["internal", "refp0", "refp1", "avdd"]
    description: |
      Reference (CONFIG2 VREF[1:0]): the bridge excitation on REFP0/REFN0
      makes the measurement ratiometric.

  pga-bypass:
    type: boolean
    description: "Bypass the PGA (only gains 1, 2 and 4)."

  low-side-switch:
    type: boolean
    description: |
      Use the low-side power switch between AIN3/REFN1 and AVSS (CONFIG2
      PSW): it closes on START/SYNC and opens on POWERDOWN (8.3.9). The
      power meter switches the excitation with the TPS22916 instead.
```

## zephyr_app/modules/pm_drivers/dts/bindings/sensor/bosch,bma400.yaml
```yaml
# SPDX-License-Identifier: CC-BY-NC-4.0

description: |
  Bosch BMA400 3-axis accelerometer on SPI (4-wire), by the Zephyr sensor
  API with a data-ready trigger on INT1 and the wake-up interrupt of the low
  power mode. Register map from BST-BMA400-DS000-14 revision 2.3. Not the
  bosch,bma4xx driver of the Zephyr tree, whose register map is the one of
  the BMA422.

compatible: "bosch,bma400"

include: [sensor-device.yaml, spi-device.yaml]

properties:
  int1-gpios:
    type: phandle-array
    required: true
    description: "The INT1 pin, push-pull, active high (INT12_IO_CTRL)."

  range:
    type: int
    default: 4
    enum: [2, 4, 8, 16]
    description: "Full scale in g (ACC_CONFIG1 acc_range)."

  odr:
    type: int
    default: 100
    enum: [12, 25, 50, 100, 200, 400, 800]
    description: "Output data rate of acc_filt1 in Hz (ACC_CONFIG1 acc_odr; 12 means 12,5)."

  osr:
    type: int
    default: 0
    enum: [0, 1, 2, 3]
    description: "Oversampling of the normal mode (ACC_CONFIG1 osr): 0 is the lowest current."
```
